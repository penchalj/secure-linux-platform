## meta-secure-linux/conf/layer.conf
```bitbake
BBPATH .= ":${LAYERDIR}"
BBFILES += "${LAYERDIR}/recipes-*/*/*.bb ${LAYERDIR}/recipes-*/*/*.bbappend"

BBFILE_COLLECTIONS += "secure-linux"
BBFILE_PATTERN_secure-linux = "^${LAYERDIR}/"
BBFILE_PRIORITY_secure-linux = "10"

LAYERVERSION_secure-linux = "1"
LAYERDEPENDS_secure-linux = "core openembedded-layer security"
LAYERSERIES_COMPAT_secure-linux = "wrynose"

# Recipes that need meta-rauc are only parsed when that layer is present
BBFILES_DYNAMIC += "rauc:${LAYERDIR}/dynamic-layers/rauc/recipes-*/*/*.bb"
```
